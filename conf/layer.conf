## conf/machine/cyclone5-gsrd.conf
```bitbake
#@TYPE: Machine
#@NAME: cyclone5
#@DESCRIPTION: Machine configuration for the Cyclone V SoC" 

IMAGE_TYPE:cyclone5 ?= "gsrd"

KERNEL_DEVICETREE:cyclone5 = "intel/socfpga/socfpga_cyclone5_socdk.dtb"

EXTRA_IMAGEDEPENDS:append:cyclone5 = " hw-ref-design u-boot-socfpga-scr"

IMAGE_BOOT_FILES:cyclone5 = " \
	socfpga_cyclone5_socdk.dtb \
	${KERNEL_IMAGETYPE} \
	${UBOOT_BINARY} \
	extlinux.conf;extlinux/extlinux.conf \
	u-boot.scr \
	${MACHINE}_${IMAGE_TYPE}_ghrd/soc_system.rbf;soc_system.rbf \
	"
```

## recipes-bsp/u-boot/files/agilex3_uboot_script.its
```
// SPDX-License-Identifier: GPL-2.0
/*
 * Copyright (C) 2025 Altera Corporation
 *
 */

/dts-v1/;

/ {
    description = "FIT image for u-boot script";
    #address-cells = <1>;

    images {
        script {
            description = "Agilex3 u-boot script";
            data = /incbin/("./agilex3_uboot.txt");
            type = "script";
            compression = "none";
            hash-1 {
                algo = "sha256";
            };
        };
    };

    configurations {
        default = "conf-1";
        conf-1 {
            description = "Boot script configuration";
            script = "script";
            signature-1 {
                algo = "sha256,rsa2048";
                key-name-hint = "dev";
                sign-images = "script";
            };
        };
    };
};
```

## recipes-kernel/linux/linux-socfpga-lts/fit_kernel_agilex5.its
```
// SPDX-License-Identifier: GPL-2.0
/*
 * Copyright (C) 2025 Altera Corporation
 *
 */

/dts-v1/;

/ {
	description = "FIT image with kernel, DTB and FPGA core binary";
	#address-cells = <1>;

	images {
		kernel {
			description = "Linux Kernel";
			data = /incbin/("./Image.lzma");
			type = "kernel";
			arch = "arm64";
			os = "linux";
			compression = "lzma";
			load = <0x86000000>;
			entry = <0x86000000>;
			hash {
				algo = "sha256";
			};
		};

		fdt-0 {
			description = "socfpga_socdk";
			data = /incbin/("./socfpga_agilex5_socdk.dtb");
			type = "flat_dt";
			arch = "arm64";
			compression = "none";
			hash {
				algo = "sha256";
			};
		};
	};

	configurations {
		default = "board-0";

		board-0 {
			description = "board_0";
			kernel = "kernel";
			fdt = "fdt-0";
			signature {
				algo = "sha256,rsa2048";
				key-name-hint = "dev";
				sign-images = "kernel", "fdt";
			};
		};
	};
};
```

## recipes-kernel/linux/linux-socfpga-lts/fit_kernel_agilex5_dk_a5e013bb32aes_5s.its
```
// SPDX-License-Identifier: GPL-2.0
/*
 * Copyright (C) 2025 Altera Corporation
 *
 */

/dts-v1/;

/ {
	description = "FIT image with kernel, DTB and FPGA core binary";
	#address-cells = <1>;

	images {
		kernel {
			description = "Linux Kernel";
			data = /incbin/("./Image.lzma");
			type = "kernel";
			arch = "arm64";
			os = "linux";
			compression = "lzma";
			load = <0x86000000>;
			entry = <0x86000000>;
			hash {
				algo = "sha256";
			};
		};

		fdt-0 {
			description = "socfpga_socdk_vanilla";
			data = /incbin/("./socfpga_agilex5_vanilla.dtb");
			type = "flat_dt";
			arch = "arm64";
			compression = "none";
			hash {
				algo = "sha256";
			};
		};

		fdt-2 {
            description = "socfpga_socdk_emmc";
            data = /incbin/("./socfpga_agilex5_socdk_emmc.dtb");
            type = "flat_dt";
            arch = "arm64";
            compression = "none";
			hash {
                algo = "sha256";
            };
        };

		fdt-4 {
            description = "socfpga_socdk_combined";
            data = /incbin/("./socfpga_agilex5_socdk.dtb");
            type = "flat_dt";
            arch = "arm64";
            compression = "none";
            hash {
                algo = "sha256";
            };
        };

		fdt-10 {
            description = "socfpga_socdk_tsn_cfg2";
            data = /incbin/("./socfpga_agilex5_socdk_tsn_cfg2.dtb");
            type = "flat_dt";
            arch = "arm64";
            compression = "none";
            hash {
                algo = "sha256";
            };
        };

		fpga-2 {
            description = "FPGA bitstream for EMMC";
            data = /incbin/("./emmc.core.rbf");
            type = "fpga";
            arch = "arm64";
            compression = "none";
            load = <0x8A000000>;
            hash {
                algo = "sha256";
            };
        };

        fpga-4 {
            description = "FPGA bitstream for GHRD";
            data = /incbin/("./ghrd.core.rbf");
            type = "fpga";
            arch = "arm64";
            compression = "none";
            load = <0x8A000000>;
            hash {
                algo = "sha256";
            };
        };

		fpga-6 {
            description = "FPGA bitstream for TSN CONFIG2";
            data = /incbin/("./tsnconfig2.core.rbf");
            type = "fpga";
            arch = "arm64";
            compression = "none";
            load = <0x8A000000>;
            hash {
                algo = "sha256";
            };
        };
	};

	configurations {
		default = "board-0";

		board-0 {
			description = "board_0";
			kernel = "kernel";
			fdt = "fdt-0";
			signature {
				algo = "sha256,rsa2048";
				key-name-hint = "dev";
				sign-images = "kernel", "fdt";
			};
		};

		board-2 {
            description = "board_2";
            kernel = "kernel";
            fdt = "fdt-2";
            fpga = "fpga-2";
            signature {
                algo = "sha256,rsa2048";
                key-name-hint = "dev";
                sign-images = "kernel", "fdt", "fpga";
            };
        };

        board-4 {
            description = "board_4";
            kernel = "kernel";
            fdt = "fdt-4";
            fpga = "fpga-4";
            signature {
                algo = "sha256,rsa2048";
                key-name-hint = "dev";
                sign-images = "kernel", "fdt", "fpga";
            };
        };

		board-10 {
            description = "board_10";
            kernel = "kernel";
            fdt = "fdt-10";
            fpga = "fpga-6";
            signature {
                algo = "sha256,rsa2048";
                key-name-hint = "dev";
                sign-images = "kernel", "fdt", "fpga";
            };
        };
	};
};
```

## recipes-kernel/linux/linux-socfpga-lts/fit_kernel_agilex5_dk_a5e065bb32aes1.its
```
// SPDX-License-Identifier: GPL-2.0
/*
 * Copyright (C) 2025 Altera Corporation
 *
 */

/dts-v1/;

/ {
	description = "FIT image with kernel, DTB and FPGA core binary";
	#address-cells = <1>;

	images {
		kernel {
			description = "Linux Kernel";
			data = /incbin/("./Image.lzma");
			type = "kernel";
			arch = "arm64";
			os = "linux";
			compression = "lzma";
			load = <0x86000000>;
			entry = <0x86000000>;
			hash {
				algo = "sha256";
			};
		};

		fdt-0 {
			description = "socfpga_socdk_vanilla";
			data = /incbin/("./socfpga_agilex5_vanilla_a0.dtb");
			type = "flat_dt";
			arch = "arm64";
			compression = "none";
			hash {
				algo = "sha256";
			};
		};

		fdt-2 {
            		description = "socfpga_socdk_emmc";
            		data = /incbin/("./socfpga_agilex5_socdk_emmc_a0.dtb");
            		type = "flat_dt";
            		arch = "arm64";
            		compression = "none";
			hash {
               			algo = "sha256";
            		};
        	};
		
		fdt-4 {
            		description = "socfpga_socdk_combined";
            		data = /incbin/("./socfpga_agilex5_socdk_a0.dtb");
            		type = "flat_dt";
            		arch = "arm64";
            		compression = "none";
            		hash {
                		algo = "sha256";
            		};
        	};
		
		fdt-5 {
			description = "socfpga_socdk_debug";
			data = /incbin/("./socfpga_agilex5_socdk_debug_a0.dtb");
			type = "flat_dt";
			arch = "arm64";
			compression = "none";
			hash {
				algo = "sha256";
			};
		};

		fdt-8 {
			description = "vanilla-socfpga_socdk_emmc.dtb";
			data = /incbin/("./socfpga_agilex5_socdk_emmc_vanilla_a0.dtb");
			type = "flat_dt";
			arch = "arm64";
			compression = "none";
			hash {
				algo = "sha256";
			};
		};

		fdt-9 {
			description = "vanilla-socfpga_socdk_debug.dtb";
			data = /incbin/("./socfpga_agilex5_socdk_debug_vanilla_a0.dtb");
			type = "flat_dt";
			arch = "arm64";
			compression = "none";
			hash {
				algo = "sha256";
			};
		};

                fdt-10 {
                        description = "socfpga_socdk_tsn_cfg2.dtb";
                        data = /incbin/("./socfpga_agilex5_socdk_tsn_cfg2_a0.dtb");
                        type = "flat_dt";
                        arch = "arm64";
                        compression = "none";
                        hash {
                                algo = "sha256";
                        };
                };

		fpga-2 {
            		description = "FPGA bitstream for EMMC";
            		data = /incbin/("./emmc.core.rbf");
            		type = "fpga";
            		arch = "arm64";
            		compression = "none";
            		load = <0x8A000000>;
            		hash {
                		algo = "sha256";
            		};
        	};

        	fpga-4 {
            		description = "FPGA bitstream for GHRD";
            		data = /incbin/("./ghrd.core.rbf");
            		type = "fpga";
            		arch = "arm64";
            		compression = "none";
            		load = <0x8A000000>;
            		hash {
                		algo = "sha256";
            		};
        	};

        	fpga-5 {
            		description = "FPGA bitstream for debug2";
            		data = /incbin/("./debug2.core.rbf");
            		type = "fpga";
            		arch = "arm64";
            		compression = "none";
            		load = <0x8A000000>;
            		hash {
                		algo = "sha256";
            		};
        	};

                fpga-6 {
                        description = "FPGA bitstream for TSN CONFIG2";
                        data = /incbin/("./tsnconfig2.core.rbf");
                        type = "fpga";
                        arch = "arm64";
                        compression = "none";
                        load = <0x8A000000>;
                        hash {
                                algo = "sha256";
                        };
                };
	};

	configurations {
		default = "board-0";

		board-0 {
			description = "board_0";
			kernel = "kernel";
			fdt = "fdt-0";
			signature {
				algo = "sha256,rsa2048";
				key-name-hint = "dev";
				sign-images = "kernel", "fdt";
			};
		};

		board-2 {
            		description = "board_2";
            		kernel = "kernel";
            		fdt = "fdt-2";
            		fpga = "fpga-2";
            		signature {
                		algo = "sha256,rsa2048";
                		key-name-hint = "dev";
                		sign-images = "kernel", "fdt", "fpga";
            		};
        	};

        	board-4 {
            		description = "board_4";
            		kernel = "kernel";
            		fdt = "fdt-4";
            		fpga = "fpga-4";
            		signature {
                		algo = "sha256,rsa2048";
                		key-name-hint = "dev";
                		sign-images = "kernel", "fdt", "fpga";
            		};
        	};

        	board-5 {
            		description = "board_5";
            		kernel = "kernel";
            		fdt = "fdt-5";
            		fpga = "fpga-5";
            		signature {
                		algo = "sha256,rsa2048";
                		key-name-hint = "dev";
                		sign-images = "kernel", "fdt", "fpga";
            		};
        	};

        	board-8 {
            		description = "board_8";
            		kernel = "kernel";
            		fdt = "fdt-8";
            		signature {
                		algo = "sha256,rsa2048";
                		key-name-hint = "dev";
                		sign-images = "kernel", "fdt";
            		};
        	};

        	board-9 {
            		description = "board_9";
            		kernel = "kernel";
            		fdt = "fdt-9";
            		signature {
                		algo = "sha256,rsa2048";
                		key-name-hint = "dev";
                		sign-images = "kernel", "fdt";
            		};
        	};

                board-10 {
                        description = "board_10";
                        kernel = "kernel";
                        fdt = "fdt-10";
                        fpga = "fpga-6";
                        signature {
                                algo = "sha256,rsa2048";
                                key-name-hint = "dev";
                                sign-images = "kernel", "fdt", "fpga";
                        };
                };

	};
};
```

## recipes-kernel/linux/linux-socfpga-lts/fit_kernel_agilex5_mk_a5e065bb32aes1.its
```
// SPDX-License-Identifier: GPL-2.0
/*
 * Copyright (C) 2025 Altera Corporation
 *
 */

/dts-v1/;

/ {
	description = "FIT image with kernel, DTB and FPGA core binary";
	#address-cells = <1>;

	images {
		kernel {
			description = "Linux Kernel";
			data = /incbin/("./Image.lzma");
			type = "kernel";
			arch = "arm64";
			os = "linux";
			compression = "lzma";
			load = <0x86000000>;
			entry = <0x86000000>;
			hash {
				algo = "sha256";
			};
		};

		fdt-0 {
			description = "socfpga_socdk_vanilla";
			data = /incbin/("./socfpga_agilex5_vanilla_modular.dtb");
			type = "flat_dt";
			arch = "arm64";
			compression = "none";
			hash {
				algo = "sha256";
			};
		};

		fdt-4 {
            description = "socfpga_socdk_combined";
            data = /incbin/("./socfpga_agilex5_socdk_modular.dtb");
            type = "flat_dt";
            arch = "arm64";
            compression = "none";
            hash {
                algo = "sha256";
            };
        };

        fpga-4 {
            description = "FPGA bitstream for GHRD";
            data = /incbin/("./ghrd.core.rbf");
            type = "fpga";
            arch = "arm64";
            compression = "none";
            load = <0x8A000000>;
            hash {
                algo = "sha256";
            };
        };
	};

	configurations {
		default = "board-0";

		board-0 {
			description = "board_0";
			kernel = "kernel";
			fdt = "fdt-0";
			signature {
				algo = "sha256,rsa2048";
				key-name-hint = "dev";
				sign-images = "kernel", "fdt";
			};
		};

        board-4 {
            description = "board_4";
            kernel = "kernel";
            fdt = "fdt-4";
            fpga = "fpga-4";
            signature {
                algo = "sha256,rsa2048";
                key-name-hint = "dev";
                sign-images = "kernel", "fdt", "fpga";
            };
        };
	};
};
```

## recipes-kernel/linux/linux-socfpga-lts/fit_kernel_n5x.its
```
// SPDX-License-Identifier: GPL-2.0
/*
 * Copyright (C) 2026 Altera Corporation
 *
 * N5X kernel FIT (formerly produced by U-Boot binman; binman kernel node
 * deleted in socfpga_v2026.07). Matches prior binman layout: uncompressed
 * Image + socdk DTB at 0x6000000.
 */
/dts-v1/;
/ {
	description = "FIT with Linux kernel image and FDT blob";
	#address-cells = <1>;
	images {
		kernel {
			description = "Linux Kernel";
			data = /incbin/("./Image");
			type = "kernel";
			arch = "arm64";
			os = "linux";
			compression = "none";
			load = <0x6000000>;
			entry = <0x6000000>;
			hash {
				algo = "crc32";
			};
		};
		fdt-0 {
			description = "socfpga_n5x_socdk";
			data = /incbin/("./socfpga_n5x_socdk.dtb");
			type = "flat_dt";
			arch = "arm64";
			compression = "none";
			hash {
				algo = "crc32";
			};
		};
	};
	configurations {
		default = "conf";
		conf {
			description = "N5X SOCDK";
			kernel = "kernel";
			fdt = "fdt-0";
			signature {
				algo = "crc32";
				key-name-hint = "dev";
				sign-images = "fdt-0", "kernel";
			};
		};
	};
};
```
